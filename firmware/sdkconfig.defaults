## firmware/sdkconfig.defaults
```kconfig
# mbedTLS heap tuning — the whole point of switching to
# framework = arduino, espidf. Lets a github.com TLS handshake fit in
# the ~31 KB largest free block we have after a full boot, instead of
# requiring the ~36 KB the default 16 KB I/O buffers want.
CONFIG_MBEDTLS_DYNAMIC_BUFFER=y
CONFIG_MBEDTLS_ASYMMETRIC_CONTENT_LEN=y
CONFIG_MBEDTLS_SSL_IN_CONTENT_LEN=4096
CONFIG_MBEDTLS_SSL_OUT_CONTENT_LEN=2048

# Required by esp32-arduino — default IDF is 100 Hz, Arduino assumes 1000.
CONFIG_FREERTOS_HZ=1000

# Arduino-as-IDF-component: provide app_main shim that calls setup()/loop().
# Without this, the link fails with "undefined reference to app_main".
CONFIG_AUTOSTART_ARDUINO=y

# Flash + partition table to match the m5stack-stamps3 board (8MB, dual OTA).
CONFIG_ESPTOOLPY_FLASHSIZE_8MB=y
CONFIG_ESPTOOLPY_FLASHSIZE="8MB"
CONFIG_PARTITION_TABLE_CUSTOM=y
CONFIG_PARTITION_TABLE_CUSTOM_FILENAME="default_8MB.csv"
CONFIG_PARTITION_TABLE_FILENAME="default_8MB.csv"

# Bluetooth — controller only. NimBLE-Arduino library brings its own host;
# IDF's NimBLE host stays OFF to avoid duplicate ble_hs_* symbols at link.
CONFIG_BT_ENABLED=y
CONFIG_BT_BLUEDROID_ENABLED=n
CONFIG_BT_NIMBLE_ENABLED=n
CONFIG_BT_CONTROLLER_ENABLED=y

# mbedTLS PSK ciphersuites — required so the body of arduino-esp32's
# ssl_client.cpp actually compiles (it's entirely #if-guarded on these).
# Without these, link fails with undefined ssl_init/start_ssl_client/...
CONFIG_MBEDTLS_PSK_MODES=y
CONFIG_MBEDTLS_KEY_EXCHANGE_PSK=y

# Bundled CA roots so the OTA updater can validate github.com /
# releases.githubusercontent.com instead of relying on
# client.setInsecure(). The "DEFAULT" bundle is ~30 well-known roots
# from Mozilla's NSS, totalling ~32 KB of flash — covers GitHub today
# (DigiCert Global Root G2, ISRG Root X1) and absorbs the routine CA
# rotations that Let's Encrypt and DigiCert do. updater::installNow
# calls esp_crt_bundle_attach and sets it on every WiFiClientSecure
# before any HTTPS call.
CONFIG_MBEDTLS_CERTIFICATE_BUNDLE=y
CONFIG_MBEDTLS_CERTIFICATE_BUNDLE_DEFAULT_FULL=y
```
